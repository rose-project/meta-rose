## conf/bblayers.conf.sample
```bitbake
#
LCONF_VERSION = "1"

BBPATH = "${TOPDIR}"
BBFILES ?= ""

BBLAYERS ?= " \
    ##OEROOT##/meta \
    ##OEROOT##/meta-raspberrypi-bsp \
    ##OEROOT##/meta-qt5 \
    ##OEROOT##/meta-rose \
    "
BBLAYERS_NON_REMOVABLE ?= " \
    ##OEROOT##/meta \
    ##OEROOT##/meta-rose \
    "
```

## conf/distro/rose-base.conf
```bitbake
# ROSE Base distribution
DISTRO_NAME = "RoseBase"
DISTRO_VERSION = "0.1"

LOCALCONF_VERSION ?= "1"
LAYER_CONF_VERSION ?= "1"

DISTRO_FEATURES = "${DISTRO_FEATURES_DEFAULT} ${DISTRO_FEATURES_LIBC} sysvinit pam"
DISTRO_FEATURES_remove = "X11 wayland"
DISTRO_FEATURES_BACKFILL_CONSIDERED = "sysvinit"
VIRTUAL-RUNTIME_init_manager = "sysvinit"

DISTRO_EXTRA_RDEPENDS = ""
DISTRO_EXTRA_RRECOMMENDS = ""
```

## conf/layer.conf
```bitbake
BBPATH =. "${LAYERDIR}:"

BBFILES += "${LAYERDIR}/recipes-*/*/*.bb \
            ${LAYERDIR}/recipes-*/*/*.bbappend"

BBFILE_COLLECTIONS += "rose"
BBFILE_PATTERN_rose = "^${LAYERDIR}/"
BBFILE_PRIORITY_rose = "5"

LAYERSERIES_COMPAT_rose = "scarthgap"

LAYERVERSION_rose = "1"

LAYERDEPENDS_rose = "core openembedded-layer"
```

## scripts/lib/wic/canned-wks/rosebasic-gpt.wks
```
# short-description: Create a grub-efi image with primary/recovery partition
# long-description: Creates a partitioned gpt efi disk image that the user
# can directly dd to boot media.

#     wic create rosebasic-gpt -e rose-image-minimal \
#         --rootfs-dir rootfs_prim=rose-image-minimal
#         --rootfs-dir rootfs_rec=rose-image-minimal-recovery


part /boot/EFI --source bootimg-efi --sourceparams="loader=grub-efi" --ondisk sda --label boot --active --size 32  --align 1024 --overhead-factor=1.0
part /         --source rootfs --rootfs-dir=rootfs_prim --ondisk sda --fstype=ext4 --label primary   --size 512 --align 1024 --overhead-factor=1.0 --use-uuid
part /home     --source rootfs --rootfs-dir=rootfs_prim --ondisk sda --fstype=ext4 --label home      --size 128 --align 1024 --overhead-factor=1.0 --use-uuid --submount-dir="/home"
part /recovery --source rootfs --rootfs-dir=rootfs_rec  --ondisk sda --fstype=ext4 --label recovery  --size 512 --align 1024 --overhead-factor=1.0 --use-uuid

bootloader --ptable gpt --configfile="rosebasic-gpt.cfg"
```

## scripts/lib/wic/canned-wks/roseberry.wks
```
# short-description: Create SD card image for the Raspberry Pi
# long-description: Creates a partitioned SD card image. Boot files
# are located in the first vfat partition.

part /boot --source bootimg-partition --ondisk mmcblk --fstype=vfat --label boot --active --align 1024 --size 16 --overhead-factor=1.0
part / --source rootfs --ondisk mmcblk --fstype=ext4 --label root --align 1024 --size 512 --overhead-factor=1.0
part /recovery --source rootfs --ondisk mmcblk --fstype=ext4 --label recovery --align 1024 --size 512 --overhead-factor=1.0
```
